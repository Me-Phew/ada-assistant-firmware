## components/ada_application/Kconfig.projbuild
```kconfig
menu "Ada Application"

        config ADA_APP_EN_BTN_GPIO
        int "Enable button GPIO number"
        range 0 48
        default 15
        help
            GPIO number (IOxx) the soft enable button used to enable the device is connected to.
            This has to be an RTC capable pin.

        config ADA_APP_EN_BTN_ACTIVE_LEVEL
        int "Enable button active level"
        range 0 1
        default 0
        help
            Active level of the enable button. 0 = low, 1 = high.
            Default is 0 for a pull-up configuration.

        config ADA_APP_EN_BTN_DEBOUNCE_TIME_MS
        int "Enable button debounce time (ms)"
        range 0 1000
        default 50
        help
            Debounce time in milliseconds for the enable button.
            Default is 50ms.

        config ADA_APP_EN_BTN_POLLING_RATE_MS
        int "Enable button polling rate (ms)"
        range 0 1000
        default 100
        help
            Polling rate in milliseconds for the enable button.
            Default is 100ms.

        config ADA_APP_EN_LED_GPIO
        int "Status LED GPIO number"
        range 0 48
        default 16
        help
            GPIO number (IOxx) the status LED is connected to.

endmenu
```

## components/ada_bluetooth_manager/Kconfig.projbuild
```kconfig
menu "Ada Bluetooth Manager"
    
    config ADA_BLUETOOTH_DEVICE_NAME
        string "Bluetooth Device Name"
        default "Ada Smart Assistant"

endmenu
```

## components/ada_cloud_services/Kconfig.projbuild
```kconfig
menu "Ada Cloud Services"
    config ADA_CLOUD_SERVER_URL
        string "Server URL"
        default "http://192.168.1.13:4000/"
        help
            The URL of the server to connect to.

endmenu
```

## components/ada_hal_board/Kconfig.projbuild
```kconfig
menu "Ada Audio Board"

    config ADA_SPEAKER_DRIVER_LRCLK_GPIO
    int "LRCLK GPIO number"
    range 0 48
    default 21
    help
        GPIO number (IOxx) the LRCLK amplifier pin is connected to.
        Some GPIOs are used for other purposes (flash connections, etc.) and cannot be used.

    config ADA_SPEAKER_DRIVER_DIN_GPIO
        int "DIN GPIO number"
        range 0 48
        default 47
        help
            GPIO number (IOxx) the DIN amplifier pin is connected to.
            Some GPIOs are used for other purposes (flash connections, etc.) and cannot be used.

    config ADA_SPEAKER_DRIVER_BCLK_GPIO
        int "BCLK GPIO number"
        range 0 48
        default 48
        help
            GPIO number (IOxx) the BCLK amplifier pin is connected to.
            Some GPIOs are used for other purposes (flash connections, etc.) and cannot be used.

endmenu
```

## components/ada_led_strip_driver/Kconfig.projbuild
```kconfig
menu "Ada LED Strip Driver"

    choice ADA_LED_STRIP_BACKEND
        prompt "LED strip backend peripheral"
        default ADA_LED_STRIP_BACKEND_RMT if SOC_RMT_SUPPORTED
        default ADA_LED_STRIP_BACKEND_SPI
        help
            Select the backend peripheral to drive the LED strip.

        config ADA_LED_STRIP_BACKEND_RMT
            depends on SOC_RMT_SUPPORTED
            bool "RMT"
        config ADA_LED_STRIP_BACKEND_SPI
            bool "SPI"
    endchoice

    config ADA_LED_STRIP_GPIO_NUM
        int "GPIO number"
        range 0 48
        default 11
        help
            GPIO number (IOxx) the LED strip is connected to.
            Some GPIOs are used for other purposes (flash connections, etc.) and cannot be used.

    config ADA_LED_STRIP_STRIP_LED_COUNT
        int "Number of LEDs"
        default 14
        help
            Number of LEDs in the strip.
            This is used to allocate memory for the LED strip driver.
            The actual number of LEDs in the strip may be less than this value.

    endmenu
```

## components/ada_microphone_driver/Kconfig.projbuild
```kconfig
menu "Ada Microphone Driver"

    config ADA_MICROPHONE_DRIVER_SCK_GPIO
        int "SCK GPIO number"
        range 0 48
        default 12
        help
            GPIO number (IOxx) the SCK microphone pin is connected to.
            Some GPIOs are used for other purposes (flash connections, etc.) and cannot be used.

    config ADA_MICROPHONE_DRIVER_SD_GPIO
        int "SD GPIO number"
        range 0 48
        default 13
        help
            GPIO number (IOxx) the SD microphone pin is connected to.
            Some GPIOs are used for other purposes (flash connections, etc.) and cannot be used.

    config ADA_MICROPHONE_DRIVER_WS_GPIO
        int "WS GPIO number"
        range 0 48
        default 14
        help
            GPIO number (IOxx) the WS microphone pin is connected to.
            Some GPIOs are used for other purposes (flash connections, etc.) and cannot be used.

    config ADA_MICROPHONE_DRIVER_I2S_PORT
        int "I2S port number"
        range 0 1
        default 0
        help
            I2S number to use for the microphone driver.
            This is used to select the I2S peripheral to use for the microphone driver.
            The default is 0, which is the first I2S peripheral.
            The second I2S peripheral is 1.
    

    config ADA_MICROPHONE_DRIVER_SAMPLE_RATE
        int "Microphone sample rate"
        range 8000 48000
        default 16000
        help
            Sample rate to use for the microphone driver.
            This is used to select the sample rate for the I2S peripheral.
            The default is 16000, which is the most common sample rate for microphones.
            Other common sample rates are 8000, 11025, 22050, 32000, 44100, and 48000.


    config ADA_MICROPHONE_DRIVER_BITS_PER_SAMPLE
        int "Microphone bits per sample"
        range 8 32
        default 32
        help
            Bits per sample to use for the microphone driver.
            This is used to select the bits per sample for the I2S peripheral.
            The default is 32, which used for the INMP441 microphone.
            Other common bits per sample are 8, 16 and 24.
endmenu
```

## components/ada_speaker_driver/Kconfig.projbuild
```kconfig
menu "Ada Speaker Driver"

    config ADA_SPEAKER_DRIVER_I2S_PORT
        int "I2S port number"
        range 0 1
        default 0
        help
            I2S number to use for the microphone driver.
            This is used to select the I2S peripheral to use for the microphone driver.
            The default is 0, which is the first I2S peripheral.
            The second I2S peripheral is 1.

    config ADA_SPEAKER_DRIVER_SAMPLE_RATE
        int "Sample rate"
        range 8000 96000
        default 44100
        help
            Sample rate to use for the microphone driver.
            This is used to select the sample rate for the I2S peripheral.
            The default is 44100, which offers great audio quality.

    config ADA_SPEAKER_DRIVER_BITS_PER_SAMPLE
        int "Bits per sample"
        range 8 32
        default 16
        help
            Bits per sample to use for the microphone driver.
            This is used to select the bits per sample for the I2S peripheral.
            The default is 16, which offers great audio quality.
endmenu
```

## components/ada_wake_word_detection_engine/Kconfig.projbuild
```kconfig
menu "Ada Wake Word Detection Engine"

    config ADA_WAKE_WORD_DETECTION_ENGINE_PROPABILITY_CUTOFF
        int "Wake word detection engine propability cutoff"
        range 1 100
        default 97
        help
            The propability cutoff for the wake word detection engine.
            The value is a percentage (1-100) and determines the minimum
            confidence level required to trigger the wake word detection.
            A higher value means a more confident detection, but may miss some
            detections. A lower value means a less confident detection, but may
            trigger false positives.
            Default is 97%.

    config ADA_WAKE_WORD_DETECTION_ENGINE_SLIDING_WINDOW_AVERAGE_SIZE
        int "Wake word detection engine sliding window average size"
        range 1 100
        default 10
        help
            The size of the sliding window used to calculate the average
            confidence level for the wake word detection engine.
            A larger window size means a smoother average, but may introduce
            more latency. A smaller window size means a more responsive average,
            but may be more jittery.
            Default is 10.
endmenu
```

## components/ada_wifi_manager/Kconfig.projbuild
```kconfig
menu "Ada WiFi Manager"

    config ADA_WIFI_MAX_RETRIES
        int "Max WiFi Connection Retries"
        default 5
        range 1 10
        help
            Maximum number of retries to connect to WiFi before giving up.
    
    config ADA_WIFI_TIMEOUT
        int "WiFi Connection Timeout (seconds)"
        default 30
        range 1 120
        help
            Timeout duration for WiFi connection attempts.

endmenu
```
